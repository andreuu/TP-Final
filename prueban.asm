#INCLUDE <P16F628A.inc>

__CONFIG 3F10 && _WDT_OFF && _LVP_OFF

		CBLOCK 0x20
		CONT1
		CONT2
		DIG_DSP1
		DIG_DSP2
		DIG_DSP3
		DIG_DSP4
		D1
		D2
		D3
		D4
		AUX_W
		AUX_STATUS
		AUX
		FLAG_M
		N1_UNIDAD
		N1_DECENA
		N1_CENTENA
		N2_UNIDAD
		N2_DECENA
		N2_CENTENA
		ENDC

;DECLARACION DE CONSTATNES

#DEFINE BTN_G1 	PORTA,6
#DEFINE BTN_G2 	PORTA,7
#DEFINE BTN_R 	PORTA,4
#DEFINE BTN_M 	PORTB,0

#DEFINE PIN_D1 	1
#DEFINE PIN_D2 	0
#DEFINE PIN_D3 	2
#DEFINE PIN_D4 	3

;DECLARACION DE MACROS

MOSTRAR	MACRO	DIGITO,PIN
		CLRF	PORTA
		MOVF	DIGITO,W
		CALL	TAB_DISPLAY
		MOVWF	PORTB
		BSF		PORTA,PIN
		ENDM

LEER_EEPROM	MACRO DATO,DIR

	BCF		STATUS,RP0
	MOVLW	DIR
	BSF		STATUS,RP0
	MOVWF	EEADR
	BSF		EECON1,RD
	BTFSC	EECON1,RD
	GOTO	$-1
	BCF		EECON1,EEIF
	MOVF	EEDATA,W
	BCF		STATUS,RP0
	MOVWF	DATO

	ENDM

ESCRIBIR_EEPROM MACRO DATO,DIR
		
		MOVLW DIR
		BSF	STATUS,RP0
		MOVWF EEADR
		BCF	STATUS,RP0
		MOVF DATO,W
		BSF	STATUS,RP0
		MOVWF EEDATA
		BSF	EECON1,WREN
		BCF	INTCON,GIE
		MOVLW 0x55
		MOVWF EECON2
		MOVLW 0xAA
		MOVWF EECON2
		BSF 	EECON1,WR
		BTFSC 	EECON1,WR
		GOTO 	$-1
		BCF 	EECON1,WREN
		BSF		INTCON,GIE
		BCF 	STATUS,RP0

		ENDM

;INICIO DEL PROGRAMA

	ORG 0x00
	GOTO CONFI
	
	ORG	0X04
;RUTINA DE INTERRUPCION
;GUARDA STATUS Y W EN VARIABLES AUXILIARES
		BCF		INTCON,T0IF
		BCF		INTCON,GIE		
		MOVWF	AUX_W
		MOVLW	STATUS
		MOVWF	AUX_STATUS

;MULTIPLEXADO DE DISPLAYS
		BTFSC	PORTA,PIN_D1
		GOTO	MOSTRAR_D2			
		BTFSC	PORTA,PIN_D2
		GOTO	MOSTRAR_D3
		BTFSC	PORTA,PIN_D3
		GOTO	MOSTRAR_D4
		
		MOSTRAR	DIG_DSP1,PIN_D1
		GOTO 	FIN_T0I

MOSTRAR_D2
		MOSTRAR DIG_DSP2,PIN_D2
		GOTO 	FIN_T0I

MOSTRAR_D3
		MOSTRAR DIG_DSP3,PIN_D3
		GOTO 	FIN_T0I

MOSTRAR_D4
		MOSTRAR	DIG_DSP4,PIN_D4
		
FIN_T0I
;REINICIA TIMER Y RECUPERA STATUS Y W
		MOVLW	.198
		MOVWF	TMR0
		MOVF	AUX_STATUS,W
		MOVWF	STATUS
		MOVF	AUX_W,W
		RETFIE

;CONFIGURACION
		
CONFI
		MOVLW	0X07
		MOVWF	CMCON ; CMCON SE TIENE QUE ESTABLECER EN 7 PARA USAR TODO EL PORTA
		MOVLW	.198
		MOVWF	TMR0
		BSF		STATUS,RP0
		MOVLW	b'00000001'
		MOVWF	TRISB	
		MOVLW	b'11110000'
		MOVWF	TRISA
		MOVLW	b'00000111'
		MOVWF	OPTION_REG
		BSF		INTCON,GIE
		BSF		INTCON,T0IE
		
		BCF		STATUS,RP0
		CLRF	FLAG_M

;RUTINA PRINCIPAL

		CLRF	PORTA
		CLRF	PORTB
				
BOTONES
		
		BTFSC	BTN_G1
		CALL	BOTON_G1

		BTFSC	BTN_G2
		CALL 	BOTON_G2

		BTFSC	BTN_M
		CALL	BOTON_M

		BTFSC	BTN_R
		CALL 	BOTON_R

		GOTO	BOTONES

BOTON_G1
		CALL 	DELAY_20MS
		BTFSC	BTN_G1
		RETURN
		CALL	INCREMENTAR
		;CALL	GUARDAR

		RETURN

BOTON_G2
		CALL 	DELAY_20MS
		BTFSC	BTN_G2
		RETURN
		CALL	DECREMENTAR
		;CALL	GUARDAR
		RETURN

BOTON_M
		CALL 	DELAY_20MS
		BTFSC	BTN_M
		RETURN

		BTFSS	FLAG_M,7
		GOTO	BOTON_M1
		GOTO	BOTON_M2
FIN_M
		RETURN

BOTON_M1
		COMF	FLAG_M
		MOVF	DIG_DSP1,W
		MOVWF	N1_UNIDAD
		MOVF	DIG_DSP2,W
		MOVWF	N1_DECENA
		MOVF	DIG_DSP3,W
		MOVWF	N1_CENTENA
		CLRF	DIG_DSP1
		CLRF	DIG_DSP2
		CLRF	DIG_DSP3
		CLRF	DIG_DSP4
		GOTO	FIN_M

BOTON_M2
		MOVF	DIG_DSP1,W
		MOVWF	N2_UNIDAD
		MOVF	DIG_DSP2,W
		MOVWF	N2_DECENA
		MOVF	DIG_DSP3,W
		MOVWF	N2_CENTENA
		GOTO	VERIFICAR

VERIFICAR
		MOVF	N2_CENTENA,W
		SUBWF	N1_CENTENA,W
		BTFSS	STATUS,C
		CALL	INVERTIR
		BTFSS	STATUS,Z
		GOTO	RESTA
		MOVF	N2_DECENA,W
		SUBWF	N1_DECENA,W
		BTFSS	STATUS,C
		CALL	INVERTIR
		BTFSS	STATUS,Z
		GOTO	RESTA
		MOVF	N2_UNIDAD,W
		SUBWF	N1_UNIDAD,W
		BTFSS	STATUS,C
		CALL	INVERTIR
		GOTO	RESTA

INVERTIR

	MOVF	N1_CENTENA,W
	MOVWF	AUX
	MOVF	N2_CENTENA,W
	MOVWF	N1_CENTENA
	MOVF	AUX,W
	MOVWF	N2_CENTENA


	MOVF	N1_DECENA,W
	MOVWF	AUX
	MOVF	N2_DECENA,W
	MOVWF	N1_DECENA
	MOVF	AUX,W
	MOVWF	N2_DECENA
	
	MOVF	N1_UNIDAD,W
	MOVWF	AUX
	MOVF	N2_UNIDAD,W
	MOVWF	N1_UNIDAD
	MOVF	AUX,W
	MOVWF	N2_UNIDAD


	MOVLW	.10	;Agrego el signo en el 4to display
	MOVWF	DIG_DSP4

	RETURN


OP_CARRY_UNIDAD
	
	;CHEQUEA UNIDAD
	BSF		STATUS,C
	DECF	N1_DECENA,W;SE LE PIDE 1 A LA DECENA
	BTFSC	STATUS,C
	GOTO SEGUIR

	BSF		STATUS,C
	;SI LA DECENA NO TIENE, SE LE PIDE 1 A LA CENTENA PA LA DECENA
	DECF	N1_CENTENA,F
	MOVF	N1_DECENA,W
	ADDLW	.10
	MOVWF	N1_DECENA

	SEGUIR
	DECF	N1_DECENA,F
	;SI LE PUDIMOS PEDIR 1 A LA DECENA, SE SUMA 10 A LA UNIDAD
	MOVF	N1_UNIDAD,W
	ADDLW	.10
	MOVWF	N1_UNIDAD

	MOVF	N2_UNIDAD,W
	SUBWF	N1_UNIDAD,W

	
	RETURN
	
OP_CARRY_DECENA
	
	;CHEQUEA CENTENA
	BSF		STATUS,C
	DECF	N1_CENTENA,F;SE LE PIDE 1 A LA CENTENARIA CONCHA DE TUMADRE
	
	;SI LE PUDIMOS PEDIR 1 A LA CEN, SE SUMA 10 A LA DECENA
	MOVF	N1_DECENA,W
	ADDLW	.10
	MOVWF	N1_DECENA

	MOVF	N2_DECENA,W
	SUBWF	N1_DECENA,W
	
	RETURN

RESTA
	MOVF	N2_UNIDAD,W
	SUBWF	N1_UNIDAD,W
	BTFSS	STATUS,C
	CALL	OP_CARRY_UNIDAD
	MOVWF	N1_UNIDAD
	MOVWF	DIG_DSP1

	MOVF	N2_DECENA,W
	SUBWF	N1_DECENA,W
	BTFSS	STATUS,C
	CALL	OP_CARRY_DECENA
	MOVWF	N1_DECENA
	MOVWF	DIG_DSP2

	MOVF	N2_CENTENA,W
	SUBWF	N1_CENTENA,W
	MOVWF	N1_CENTENA
	MOVWF	DIG_DSP3

	GOTO	FIN_M

BOTON_R
		CLRF	DIG_DSP1
		CLRF	DIG_DSP2
		CLRF	DIG_DSP3
		CLRF	DIG_DSP4
		CLRF	FLAG_M
		;CALL	GUARDAR

		RETURN

;GUARDAR	
		;ESCRIBIR_EEPROM	DIG_DSP1,0X00
		;ESCRIBIR_EEPROM 	DIG_DSP2,0X01
		;ESCRIBIR_EEPROM	DIG_DSP3,0X02
		;ESCRIBIR_EEPROM	DIG_DSP4,0X03
		
		;RETURN


INCREMENTAR
	INCF	DIG_DSP1,F
	MOVF	DIG_DSP1,W
	XORLW	.10
	BTFSS	STATUS,Z
	GOTO	FIN_RUT
	CLRF	DIG_DSP1
	INCF	DIG_DSP2,F
	MOVF	DIG_DSP2,W
	XORLW	.10
	BTFSS	STATUS,Z
	GOTO	FIN_RUT
	CLRF	DIG_DSP2
	INCF	DIG_DSP3,F
	MOVF	DIG_DSP3,W
	XORLW	.10
	BTFSS	STATUS,Z
	GOTO	FIN_RUT
	CLRF	DIG_DSP3
FIN_RUT	
	RETURN

DECREMENTAR
	DECF	DIG_DSP1,F
	MOVF	DIG_DSP1,W
	XORLW	0xff
	BTFSS	STATUS,Z
	GOTO	END_RUT
	MOVLW	.9
	MOVWF	DIG_DSP1
	DECF	DIG_DSP2,F
	MOVF	DIG_DSP2,W
	XORLW	0xff
	BTFSS	STATUS,Z
	GOTO	END_RUT
	MOVLW	.9
	MOVWF	DIG_DSP2
	DECF	DIG_DSP3,F
	MOVF	DIG_DSP3,W
	XORLW	0xff
	BTFSS	STATUS,Z
	GOTO	END_RUT
	MOVLW	.9
	MOVWF	DIG_DSP3
	
END_RUT
	RETURN
	
		
DELAY_20MS
	MOVLW	.250
	MOVWF	CONT1
	MOVLW	.20
	MOVWF	CONT2
L1	NOP
	DECFSZ	CONT1,F
	GOTO	L1
L2	DECFSZ	CONT2,F
	GOTO	L2
	RETURN 

TAB_DISPLAY
	ADDWF	PCL,1
	;         GFEDCBA-
	RETLW	b'01111111' ;0
	RETLW	b'00001101' ;1
	RETLW	b'10110111' ;2
	RETLW	b'10011111' ;3
	RETLW	b'11001101' ;4
	RETLW	b'11011011' ;5
	RETLW	b'11111011' ;6
	RETLW	b'00001111' ;7
	RETLW	b'11111111' ;8
	RETLW	b'11001111' ;9
	RETLW	b'10000001' ;-
		
END
